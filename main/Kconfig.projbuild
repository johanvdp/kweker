## main/Kconfig.projbuild
```kconfig
menu "Kweker"

    config GPIO_LED
        int "LED GPIO number"
        range 0 33
        default 2
        help
            GPIO number (GPIO_NUM_xx) to control LED (1:on).

    config GPIO_AM2301
        int "AM2301 GPIO number"
        range 0 33
        default 4
        help
            GPIO number (GPIO_NUM_xx) to AM2301 sensor.

    config GPIO_LIGHT
        int "Light GPIO number"
        range 0 33
        default 2
        help
            GPIO number (GPIO_NUM_xx) to light SSR.

    config GPIO_EXHAUST
        int "Exhaust fan GPIO number"
        range 0 33
        default 2
        help
            GPIO number (GPIO_NUM_xx) to exhaust fan SSR.

    config GPIO_RECIRC
        int "Recirculation fan GPIO number"
        range 0 33
        default 2
        help
            GPIO number (GPIO_NUM_xx) to recirculation fan SSR.

    config GPIO_HEATER
        int "Heater GPIO number"
        range 0 33
        default 2
        help
            GPIO number (GPIO_NUM_xx) to heater SSR.

    config SPI_HOST_A
        int "SPI host"
        range 0 2
        default 1
        help
            SPI host.

    config GPIO_SPI_A_MISO
        int "SPI MISO GPIO number"
        range 0 33
        default 12
        help
            GPIO number (GPIO_NUM_xx) to SPI MISO.

    config GPIO_SPI_A_MOSI
        int "SPI SPI MOSI GPIO number"
        range 0 33
        default 13
        help
            GPIO number (GPIO_NUM_xx) to SPI MOSI.

    config GPIO_SPI_A_CLK
        int "SPI SPI CLK GPIO number"
        range 0 33
        default 14
        help
            GPIO number (GPIO_NUM_xx) to SPI CLK.

    config SPI_HOST_DS3234
        int "DS3234 SPI host"
        range 0 2
        default 1
        help
            DS3234 SPI host.

    config GPIO_DS3234_CS
        int "DS3234 CS GPIO number"
        range 0 33
        default 15
        help
            GPIO number (GPIO_NUM_xx) to DS3234 CS.

    config UART_PORT_MHZ19B
        int "MH-Z19B UART port"
        range 0 2
        default 2
        help
            MH-Z19B UART port.

    config GPIO_MHZ19B_TXD
        int "MH-Z19B TXD GPIO number"
        range 0 33
        default 17
        help
            GPIO number (GPIO_NUM_xx) TXD to MH-Z19B RXD.

    config GPIO_MHZ19B_RXD
        int "MH-Z19B RXD GPIO number"
        range 0 33
        default 16
        help
            GPIO number (GPIO_NUM_xx) RXD to MH-Z19B TXD.

    config SPI_HOST_MCP23S17
        int "MCP23S17 SPI host"
        range 0 2
        default 1
        help
            MCP23S17 SPI host.

    config GPIO_MCP23S17_CS
        int "MCP23S17 CS GPIO number"
        range 0 33
        default 25
        help
            GPIO number (GPIO_NUM_xx) to MCP23S17 CS.

    config MCP23S17_HOST_ADDR
        int "MCP23S17 host address"
        range 0 7
        default 0
        help
            MCP23S17 host address.

endmenu
```

## sdkconfig.defaults
```kconfig
#
# Espressif IoT Development Framework (ESP-IDF) Project Configuration
#
CONFIG_IDF_CMAKE=y
CONFIG_IDF_TARGET="esp32"
CONFIG_IDF_TARGET_ESP32=y
CONFIG_IDF_FIRMWARE_CHIP_ID=0x0000

#
# Kweker
#
CONFIG_GPIO_LED=2
CONFIG_GPIO_AM2301=4
# end of Kweker

#
# Component config
#

#
# ESP32-specific
#
# CONFIG_ESP32_DEFAULT_CPU_FREQ_80 is not set
# CONFIG_ESP32_DEFAULT_CPU_FREQ_160 is not set
CONFIG_ESP32_DEFAULT_CPU_FREQ_240=y
CONFIG_ESP32_DEFAULT_CPU_FREQ_MHZ=240
# end of ESP32-specific


#
# Driver configurations
#


#
# Log output
#
CONFIG_LOG_DEFAULT_LEVEL_INFO=y
# end of Log output



#
# LVGL configuration
#
CONFIG_LV_HOR_RES_MAX=480
CONFIG_LV_VER_RES_MAX=320
CONFIG_LV_COLOR_DEPTH_16=y
CONFIG_LV_COLOR_DEPTH=16

#
# Feature usage
#
CONFIG_LV_USE_ANIMATION=n
CONFIG_LV_USE_SHADOW=n
CONFIG_LV_USE_USER_DATA=y
# CONFIG_LV_USE_USER_DATA_FREE is not set
# end of Feature usage

#
# HAL Settings
#
CONFIG_LV_TICK_CUSTOM=y
CONFIG_LV_TICK_CUSTOM_INCLUDE="esp_timer.h"
CONFIG_LV_TICK_CUSTOM_SYS_TIME_EXPR="(esp_timer_get_time() / 1000)"
# end of HAL Settings

#
# Enable built-in fonts
#
CONFIG_LV_FONT_MONTSERRAT_8=y
CONFIG_LV_FONT_MONTSERRAT_10=y
CONFIG_LV_FONT_MONTSERRAT_12=y
# CONFIG_LV_FONT_MONTSERRAT_14 is not set
# CONFIG_LV_FONT_MONTSERRAT_16 is not set
# CONFIG_LV_FONT_MONTSERRAT_18 is not set
# CONFIG_LV_FONT_MONTSERRAT_20 is not set
# CONFIG_LV_FONT_MONTSERRAT_22 is not set
# CONFIG_LV_FONT_MONTSERRAT_24 is not set
# CONFIG_LV_FONT_MONTSERRAT_26 is not set
# CONFIG_LV_FONT_MONTSERRAT_28 is not set
# CONFIG_LV_FONT_MONTSERRAT_30 is not set
# CONFIG_LV_FONT_MONTSERRAT_32 is not set
# CONFIG_LV_FONT_MONTSERRAT_34 is not set
# CONFIG_LV_FONT_MONTSERRAT_36 is not set
# CONFIG_LV_FONT_MONTSERRAT_38 is not set
# CONFIG_LV_FONT_MONTSERRAT_40 is not set
# CONFIG_LV_FONT_MONTSERRAT_42 is not set
# CONFIG_LV_FONT_MONTSERRAT_44 is not set
# CONFIG_LV_FONT_MONTSERRAT_46 is not set
# CONFIG_LV_FONT_MONTSERRAT_48 is not set
# CONFIG_LV_FONT_UNSCII_8 is not set
# CONFIG_LV_FONT_UNSCII_16 is not set
# CONFIG_LV_FONT_MONTSERRAT12SUBPX is not set
# CONFIG_LV_FONT_MONTSERRAT28COMPRESSED is not set
# CONFIG_LV_FONT_DEJAVU_16_PERSIAN_HEBREW is not set
# CONFIG_LV_FONT_SIMSUN_16_CJK is not set
# end of Enable built-in fonts

CONFIG_LV_FONT_DEFAULT_SMALL_MONTSERRAT_8=y
# CONFIG_LV_FONT_DEFAULT_SMALL_MONTSERRAT_10 is not set
# CONFIG_LV_FONT_DEFAULT_SMALL_MONTSERRAT_12 is not set
# CONFIG_LV_FONT_DEFAULT_SMALL_MONTSERRAT_14 is not set
# CONFIG_LV_FONT_DEFAULT_SMALL_MONTSERRAT_16 is not set
# CONFIG_LV_FONT_DEFAULT_SMALL_MONTSERRAT_18 is not set
# CONFIG_LV_FONT_DEFAULT_SMALL_MONTSERRAT_20 is not set
# CONFIG_LV_FONT_DEFAULT_SMALL_MONTSERRAT_22 is not set
# CONFIG_LV_FONT_DEFAULT_SMALL_MONTSERRAT_24 is not set
# CONFIG_LV_FONT_DEFAULT_SMALL_MONTSERRAT_26 is not set
# CONFIG_LV_FONT_DEFAULT_SMALL_MONTSERRAT_28 is not set
# CONFIG_LV_FONT_DEFAULT_SMALL_MONTSERRAT_30 is not set
# CONFIG_LV_FONT_DEFAULT_SMALL_MONTSERRAT_32 is not set
# CONFIG_LV_FONT_DEFAULT_SMALL_MONTSERRAT_34 is not set
# CONFIG_LV_FONT_DEFAULT_SMALL_MONTSERRAT_36 is not set
# CONFIG_LV_FONT_DEFAULT_SMALL_MONTSERRAT_38 is not set
# CONFIG_LV_FONT_DEFAULT_SMALL_MONTSERRAT_40 is not set
# CONFIG_LV_FONT_DEFAULT_SMALL_MONTSERRAT_42 is not set
# CONFIG_LV_FONT_DEFAULT_SMALL_MONTSERRAT_44 is not set
# CONFIG_LV_FONT_DEFAULT_SMALL_MONTSERRAT_46 is not set
# CONFIG_LV_FONT_DEFAULT_SMALL_MONTSERRAT_48 is not set
# CONFIG_LV_FONT_DEFAULT_SMALL_UNSCII_8 is not set
# CONFIG_LV_FONT_DEFAULT_SMALL_UNSCII_16 is not set
# CONFIG_LV_FONT_DEFAULT_SMALL_MONTSERRAT12SUBPX is not set
# CONFIG_LV_FONT_DEFAULT_SMALL_MONTSERRAT28COMPRESSED is not set
# CONFIG_LV_FONT_DEFAULT_SMALL_DEJAVU_16_PERSIAN_HEBREW is not set
# CONFIG_LV_FONT_DEFAULT_SMALL_SIMSUN_16_CJK is not set
# CONFIG_LV_FONT_DEFAULT_NORMAL_MONTSERRAT_8 is not set
CONFIG_LV_FONT_DEFAULT_NORMAL_MONTSERRAT_10=y
# CONFIG_LV_FONT_DEFAULT_NORMAL_MONTSERRAT_12 is not set
# CONFIG_LV_FONT_DEFAULT_NORMAL_MONTSERRAT_14 is not set
# CONFIG_LV_FONT_DEFAULT_NORMAL_MONTSERRAT_16 is not set
# CONFIG_LV_FONT_DEFAULT_NORMAL_MONTSERRAT_18 is not set
# CONFIG_LV_FONT_DEFAULT_NORMAL_MONTSERRAT_20 is not set
# CONFIG_LV_FONT_DEFAULT_NORMAL_MONTSERRAT_22 is not set
# CONFIG_LV_FONT_DEFAULT_NORMAL_MONTSERRAT_24 is not set
# CONFIG_LV_FONT_DEFAULT_NORMAL_MONTSERRAT_26 is not set
# CONFIG_LV_FONT_DEFAULT_NORMAL_MONTSERRAT_28 is not set
# CONFIG_LV_FONT_DEFAULT_NORMAL_MONTSERRAT_30 is not set
# CONFIG_LV_FONT_DEFAULT_NORMAL_MONTSERRAT_32 is not set
# CONFIG_LV_FONT_DEFAULT_NORMAL_MONTSERRAT_34 is not set
# CONFIG_LV_FONT_DEFAULT_NORMAL_MONTSERRAT_36 is not set
# CONFIG_LV_FONT_DEFAULT_NORMAL_MONTSERRAT_38 is not set
# CONFIG_LV_FONT_DEFAULT_NORMAL_MONTSERRAT_40 is not set
# CONFIG_LV_FONT_DEFAULT_NORMAL_MONTSERRAT_42 is not set
# CONFIG_LV_FONT_DEFAULT_NORMAL_MONTSERRAT_44 is not set
# CONFIG_LV_FONT_DEFAULT_NORMAL_MONTSERRAT_46 is not set
# CONFIG_LV_FONT_DEFAULT_NORMAL_MONTSERRAT_48 is not set
# CONFIG_LV_FONT_DEFAULT_NORMAL_UNSCII_8 is not set
# CONFIG_LV_FONT_DEFAULT_NORMAL_UNSCII_16 is not set
# CONFIG_LV_FONT_DEFAULT_NORMAL_MONTSERRAT12SUBPX is not set
# CONFIG_LV_FONT_DEFAULT_NORMAL_MONTSERRAT28COMPRESSED is not set
# CONFIG_LV_FONT_DEFAULT_NORMAL_DEJAVU_16_PERSIAN_HEBREW is not set
# CONFIG_LV_FONT_DEFAULT_NORMAL_SIMSUN_16_CJK is not set
CONFIG_LV_FONT_DEFAULT_SUBTITLE_MONTSERRAT_8=y
# CONFIG_LV_FONT_DEFAULT_SUBTITLE_MONTSERRAT_10 is not set
# CONFIG_LV_FONT_DEFAULT_SUBTITLE_MONTSERRAT_12 is not set
# CONFIG_LV_FONT_DEFAULT_SUBTITLE_MONTSERRAT_14 is not set
# CONFIG_LV_FONT_DEFAULT_SUBTITLE_MONTSERRAT_16 is not set
# CONFIG_LV_FONT_DEFAULT_SUBTITLE_MONTSERRAT_18 is not set
# CONFIG_LV_FONT_DEFAULT_SUBTITLE_MONTSERRAT_20 is not set
# CONFIG_LV_FONT_DEFAULT_SUBTITLE_MONTSERRAT_22 is not set
# CONFIG_LV_FONT_DEFAULT_SUBTITLE_MONTSERRAT_24 is not set
# CONFIG_LV_FONT_DEFAULT_SUBTITLE_MONTSERRAT_26 is not set
# CONFIG_LV_FONT_DEFAULT_SUBTITLE_MONTSERRAT_28 is not set
# CONFIG_LV_FONT_DEFAULT_SUBTITLE_MONTSERRAT_30 is not set
# CONFIG_LV_FONT_DEFAULT_SUBTITLE_MONTSERRAT_32 is not set
# CONFIG_LV_FONT_DEFAULT_SUBTITLE_MONTSERRAT_34 is not set
# CONFIG_LV_FONT_DEFAULT_SUBTITLE_MONTSERRAT_36 is not set
# CONFIG_LV_FONT_DEFAULT_SUBTITLE_MONTSERRAT_38 is not set
# CONFIG_LV_FONT_DEFAULT_SUBTITLE_MONTSERRAT_40 is not set
# CONFIG_LV_FONT_DEFAULT_SUBTITLE_MONTSERRAT_42 is not set
# CONFIG_LV_FONT_DEFAULT_SUBTITLE_MONTSERRAT_44 is not set
# CONFIG_LV_FONT_DEFAULT_SUBTITLE_MONTSERRAT_46 is not set
# CONFIG_LV_FONT_DEFAULT_SUBTITLE_MONTSERRAT_48 is not set
# CONFIG_LV_FONT_DEFAULT_SUBTITLE_UNSCII_8 is not set
# CONFIG_LV_FONT_DEFAULT_SUBTITLE_UNSCII_16 is not set
# CONFIG_LV_FONT_DEFAULT_SUBTITLE_MONTSERRAT12SUBPX is not set
# CONFIG_LV_FONT_DEFAULT_SUBTITLE_MONTSERRAT28COMPRESSED is not set
# CONFIG_LV_FONT_DEFAULT_SUBTITLE_DEJAVU_16_PERSIAN_HEBREW is not set
# CONFIG_LV_FONT_DEFAULT_SUBTITLE_SIMSUN_16_CJK is not set
# CONFIG_LV_FONT_DEFAULT_TITLE_MONTSERRAT_8 is not set
CONFIG_LV_FONT_DEFAULT_TITLE_MONTSERRAT_12=y
# CONFIG_LV_FONT_DEFAULT_TITLE_MONTSERRAT_14 is not set
# CONFIG_LV_FONT_DEFAULT_TITLE_MONTSERRAT_16 is not set
# CONFIG_LV_FONT_DEFAULT_TITLE_MONTSERRAT_18 is not set
# CONFIG_LV_FONT_DEFAULT_TITLE_MONTSERRAT_20 is not set
# CONFIG_LV_FONT_DEFAULT_TITLE_MONTSERRAT_22 is not set
# CONFIG_LV_FONT_DEFAULT_TITLE_MONTSERRAT_24 is not set
# CONFIG_LV_FONT_DEFAULT_TITLE_MONTSERRAT_26 is not set
# CONFIG_LV_FONT_DEFAULT_TITLE_MONTSERRAT_28 is not set
# CONFIG_LV_FONT_DEFAULT_TITLE_MONTSERRAT_30 is not set
# CONFIG_LV_FONT_DEFAULT_TITLE_MONTSERRAT_32 is not set
# CONFIG_LV_FONT_DEFAULT_TITLE_MONTSERRAT_34 is not set
# CONFIG_LV_FONT_DEFAULT_TITLE_MONTSERRAT_36 is not set
# CONFIG_LV_FONT_DEFAULT_TITLE_MONTSERRAT_38 is not set
# CONFIG_LV_FONT_DEFAULT_TITLE_MONTSERRAT_40 is not set
# CONFIG_LV_FONT_DEFAULT_TITLE_MONTSERRAT_42 is not set
# CONFIG_LV_FONT_DEFAULT_TITLE_MONTSERRAT_44 is not set
# CONFIG_LV_FONT_DEFAULT_TITLE_MONTSERRAT_46 is not set
# CONFIG_LV_FONT_DEFAULT_TITLE_MONTSERRAT_48 is not set
# CONFIG_LV_FONT_DEFAULT_TITLE_UNSCII_8 is not set
# CONFIG_LV_FONT_DEFAULT_TITLE_UNSCII_16 is not set
# CONFIG_LV_FONT_DEFAULT_TITLE_MONTSERRAT12SUBPX is not set
# CONFIG_LV_FONT_DEFAULT_TITLE_MONTSERRAT28COMPRESSED is not set
# CONFIG_LV_FONT_DEFAULT_TITLE_DEJAVU_16_PERSIAN_HEBREW is not set
# CONFIG_LV_FONT_DEFAULT_TITLE_SIMSUN_16_CJK is not set
# end of Font usage

# end of LVGL configuration

#
# LVGL Touch controller
#
CONFIG_LV_TOUCH_CONTROLLER=1
CONFIG_LV_TOUCH_CONTROLLER_XPT2046=y
CONFIG_LV_TOUCH_DRIVER_PROTOCOL_SPI=y
CONFIG_LV_TOUCH_CONTROLLER_SPI_VSPI=y

#
# Touchpanel (XPT2046) Pin Assignments
#
CONFIG_LV_TOUCH_SPI_MISO=19
CONFIG_LV_TOUCH_SPI_MOSI=23
CONFIG_LV_TOUCH_SPI_CLK=18
CONFIG_LV_TOUCH_SPI_CS=22
CONFIG_LV_TOUCH_PIN_IRQ=35
# end of Touchpanel (XPT2046) Pin Assignments

#
# Touchpanel Configuration (XPT2046)
#
CONFIG_LV_TOUCH_X_MIN=160
CONFIG_LV_TOUCH_Y_MIN=128
CONFIG_LV_TOUCH_X_MAX=1900
CONFIG_LV_TOUCH_Y_MAX=1900
CONFIG_LV_TOUCH_XY_SWAP=n
CONFIG_LV_TOUCH_INVERT_X=n
CONFIG_LV_TOUCH_INVERT_Y=n
CONFIG_LV_TOUCH_DETECT_IRQ=y
# end of Touchpanel Configuration (XPT2046)
# end of LVGL Touch controller

#
# LVGL TFT Display controller
#
CONFIG_LV_PREDEFINED_DISPLAY_NONE=y
CONFIG_LV_TFT_DISPLAY_CONTROLLER_ILI9488=y
CONFIG_LV_TFT_DISPLAY_PROTOCOL_SPI=y
CONFIG_LV_PREDEFINED_PINS_38V4=y
CONFIG_LV_TFT_DISPLAY_USER_CONTROLLER_ILI9488=y
CONFIG_LV_TFT_DISPLAY_SPI_VSPI=y
CONFIG_LV_TFT_DISPLAY_SPI_TRANS_MODE_SIO=y
CONFIG_LV_TFT_DISPLAY_SPI_HALF_DUPLEX=y
CONFIG_LV_DISPLAY_ORIENTATION_LANDSCAPE_INVERTED=y
CONFIG_LV_DISPLAY_ORIENTATION=3
CONFIG_LV_DISPLAY_WIDTH=320
CONFIG_LV_DISPLAY_HEIGHT=240
CONFIG_LV_TFT_USE_CUSTOM_SPI_CLK_DIVIDER=y
CONFIG_LV_TFT_SPI_CLK_DIVIDER_2=y
CONFIG_LV_TFT_CUSTOM_SPI_CLK_DIVIDER=2

#
# Display Pin Assignments
#
CONFIG_LV_DISP_SPI_MOSI=23
CONFIG_LV_DISP_SPI_CLK=18
CONFIG_LV_DISPLAY_USE_SPI_CS=y
CONFIG_LV_DISP_SPI_CS=5
CONFIG_LV_DISPLAY_USE_DC=y
CONFIG_LV_DISP_PIN_DC=21
CONFIG_LV_DISP_PIN_RST=15
CONFIG_LV_ENABLE_BACKLIGHT_CONTROL=y
CONFIG_LV_BACKLIGHT_ACTIVE_LVL=y
CONFIG_LV_DISP_PIN_BCKL=32
# end of Display Pin Assignments
# end of LVGL TFT Display controller
# end of Component config
```
